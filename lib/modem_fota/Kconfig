## lib/modem_fota/Kconfig
```kconfig
#
# Copyright (c) 2020 Nordic Semiconductor ASA
#
# SPDX-License-Identifier: LicenseRef-BSD-5-Clause-Nordic
#

menuconfig MODEM_FOTA
	bool "nRF91 modem FOTA library"
	select BSD_LIBRARY
	select AT_CMD_PARSER

if MODEM_FOTA

config MODEM_FOTA_APN
	string "FOTA APN name"
	default ""
	help
	  Acccess Point Name to be used for all FOTA data traffic. If empty, the
	  default APN will be used.

choice MODEM_FOTA_APN_AUTH
	bool "FOTA APN authentication type"
	depends on MODEM_FOTA_APN != ""
	default MODEM_FOTA_APN_AUTH_NONE
	help
	  Authentication type for the FOTA APN.

config MODEM_FOTA_APN_AUTH_NONE
	bool "None"

config MODEM_FOTA_APN_AUTH_PAP
	bool "PAP"

config MODEM_FOTA_APN_AUTH_CHAP
	bool "CHAP"

endchoice

config MODEM_FOTA_APN_AUTH_USERNAME
	string "FOTA APN authentication username"
	depends on MODEM_FOTA_APN_AUTH_PAP || MODEM_FOTA_APN_AUTH_CHAP
	default ""
	help
	  Username for the FOTA APN authentication.

config MODEM_FOTA_APN_AUTH_PASSWORD
	string "FOTA APN authentication password"
	depends on MODEM_FOTA_APN_AUTH_PAP || MODEM_FOTA_APN_AUTH_CHAP
	default ""
	help
	  Password for the FOTA APN authentication.

choice MODEM_FOTA_APN_PDN_TYPE
	bool "PDN type for the FOTA APN"
	depends on MODEM_FOTA_APN != ""
	default MODEM_FOTA_APN_PDN_TYPE_IPV4V6
	help
	  PDN type for the FOTA APN.

config MODEM_FOTA_APN_PDN_TYPE_IPV4V6
	bool "IPv4v6"

config MODEM_FOTA_APN_PDN_TYPE_IPV4
	bool "IPv4 only"

config MODEM_FOTA_APN_PDN_TYPE_IPV6
	bool "IPv6 only"

endchoice

config MODEM_FOTA_UPDATE_CHECK_INTERVAL
	int "Interval in minutes between modem firmware update checks"
	default 20160
	help
	  Sets the time between modem firmware update checks. The default
	  interval is 14 days (20160 minutes).

config MODEM_FOTA_UPDATE_CHECK_INTERVAL_RANDOMNESS
	int "Maximum value in minutes for random component which is added to the update check interval"
	default 1440
	help
	  For example if value is set to 1440 minutes, a random component between
	  0 and 24 hours is added to the firmware update check timer. If set to 0,
	  no randomness is added.

config MODEM_FOTA_TLS_SECURITY_TAG
	int "Security tag for TLS"
	default 16842753
	help
	  Security tag to be used for the server TLS connections.

config MODEM_FOTA_ALLOWED_IN_NBIOT
	bool "FOTA allowed when connected to NB-IoT"
	default y
	help
	  Is FOTA allowed when device is connected using NB-IoT. If FOTA is not
	  allowed in NB-IoT and device is connected using NB-IoT when the timer
	  expires, the FOTA client switches to LTE M1 for the update check and
	  update.

config MODEM_FOTA_ALLOWED_DURING_ROAMING
	bool "FOTA allowed during roaming"
	default y
	help
	  Is FOTA allowed when device is connected to a roaming network.

config MODEM_FOTA_UPDATE_CHECK_BLOCKED_BY_PSM
	bool "FOTA check disallowed during LTE Power Saving Mode (PSM)"
	help
	  Is FOTA update check blocked by LTE PSM. If enabled, FOTA check will not
	  be performed during PSM, but a pending update check will be started once
	  modem wakes up from PSM.

config MODEM_FOTA_UPDATE_CHECK_IN_NBIOT_POSTPONED_BY_DATA_ACTIVITY
	bool "FOTA check is postponed in NB-IoT if data transfer is ongoing"
	help
	  If enabled, FOTA check will be skipped if device is connected using NB-IoT
	  and user data transfer is ongoing when the update check timer expires.
	  Instead the update check timer is restarted with the configured interval.

config MODEM_FOTA_DISABLE_IMSI_PREFIXES
	string "Comma separated list of USIM IMSI prefixes for which FOTA is disabled"
	default ""
	help
	  Comma separated list of IMSI prefixes for USIMs for which FOTA is
	  disabled. No whitespace is allowed in the string.

config MODEM_FOTA_DATA_INACTIVITY_TIMEOUT
	int "Maximum time in minutes to wait for data connection inactivity"
	default 60
	help
	  Sets the maximum time to wait for data connection inactivity before
	  giving up. The library waits until the data connection is inactive
	  before switching the LTE mode or rebooting the device to apply the
	  update.

config MODEM_FOTA_SERVER_RETRY_COUNT
	int "Number of retries when trying to connect to the servers"
	default 5
	help
	  Sets the number of retries when trying to connect to the DM and the
	  firmware download servers.

config MODEM_FOTA_FIRMWARE_SANITY_CHECK
	bool "Automatically revert to previous firmware version in case of job update failure"
	default y
	help
	  If enabled, the FOTA job document update after a successful firmware
	  update is used as a sanity check for the updated firmware. In case the
	  device can't connect to the LTE network or fails to update the FOTA job
	  document, the modem firmware is automatically rolled back to the previous
	  version and the FOTA job document status is updated to "rejected".

config MODEM_FOTA_SHELL
	bool "Enable shell interface"
	depends on SHELL
	help
	  Enable shell interface for the FOTA Client.

config MODEM_FOTA_SHARED_SECRET
	string "Shared secret with nRF Cloud"
	default "0123456789ABCDEF0123456789ABCDEF"
	help
	  A string of 32 hex characters (0-9, A-F). Shared secret is unique
	  per-tenant. Must be coordinated with nRF Cloud.

config MODEM_FOTA_STATIC_IP
	bool "Use static IP addresses for connecting to the servers"
	help
	  If enabled, static IP addresses will be used instead of FQDNs for
	  communication with the FOTA servers.

module=MODEM_FOTA
module-dep=LOG
module-str=Modem Firmware Over the Air client
source "${ZEPHYR_BASE}/subsys/logging/Kconfig.template.log_config"

endif # MODEM_FOTA
```
